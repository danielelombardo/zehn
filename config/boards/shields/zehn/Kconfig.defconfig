## config/boards/shields/zehn/Kconfig.defconfig
```kconfig
config ZMK_BLE
	default y


if SHIELD_ZEHN_RIGHT

config ZMK_KEYBOARD_NAME
	default "_zehn"

config ZMK_SPLIT_BLE_ROLE_CENTRAL
	default y

endif # SHIELD_ZEHN_RIGHT


if SHIELD_ZEHN_LEFT || SHIELD_ZEHN_RIGHT

config ZMK_SPLIT
	default y

endif # SHIELD_ZEHN_LEFT || SHIELD_ZEHN_RIGHT
```

## config/boards/shields/zehn/Kconfig.shield
```kconfig
config SHIELD_ZEHN_LEFT
	def_bool $(shields_list_contains,zehn_left)

config SHIELD_ZEHN_RIGHT
	def_bool $(shields_list_contains,zehn_right)
```
